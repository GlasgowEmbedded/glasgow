  .module autovec
  ; Exports
  .globl  _isr_USB
  .globl  _isr_GPIF_IE4
  ; Imports
  .globl  _isr_SUDAV
  .globl  _isr_SOF
  .globl  _isr_SUTOK
  .globl  _isr_SUSPEND
  .globl  _isr_USBRESET
  .globl  _isr_HISPEED
  .globl  _isr_EP0ACK
  .globl  _isr_EP0IN
  .globl  _isr_EP0OUT
  .globl  _isr_EP1IN
  .globl  _isr_EP1OUT
  .globl  _isr_EP2
  .globl  _isr_EP4
  .globl  _isr_EP6
  .globl  _isr_EP8
  .globl  _isr_IBN
  .globl  _isr_EP0PING
  .globl  _isr_EP1PING
  .globl  _isr_EP2PING
  .globl  _isr_EP4PING
  .globl  _isr_EP6PING
  .globl  _isr_EP8PING
  .globl  _isr_ERRLIMIT
  .globl  _isr_EP2ISOERR
  .globl  _isr_EP4ISOERR
  .globl  _isr_EP6ISOERR
  .globl  _isr_EP8ISOERR
  .globl  _isr_EP2PF
  .globl  _isr_EP4PF
  .globl  _isr_EP6PF
  .globl  _isr_EP8PF
  .globl  _isr_EP2EF
  .globl  _isr_EP4EF
  .globl  _isr_EP6EF
  .globl  _isr_EP8EF
  .globl  _isr_EP2FF
  .globl  _isr_EP4FF
  .globl  _isr_EP6FF
  .globl  _isr_EP8FF
  .globl  _isr_GPIFDONE
  .globl  _isr_GPIFWF
  ; Code
  .area   CSEG    (ABS,CODE)
  .org    0x0100
  ; Actually a jump table, not an ISR, see the TRM
_isr_USB:
_isr_GPIF_IE4:
  ljmp _isr_SUDAV
  .ds 1
  ljmp _isr_SOF
  .ds 1
  ljmp _isr_SUTOK
  .ds 1
  ljmp _isr_SUSPEND
  .ds 1
  ljmp _isr_USBRESET
  .ds 1
  ljmp _isr_HISPEED
  .ds 1
  ljmp _isr_EP0ACK
  .ds 1
  ljmp _isr_reserved
  .ds 1
  ljmp _isr_EP0IN
  .ds 1
  ljmp _isr_EP0OUT
  .ds 1
  ljmp _isr_EP1IN
  .ds 1
  ljmp _isr_EP1OUT
  .ds 1
  ljmp _isr_EP2
  .ds 1
  ljmp _isr_EP4
  .ds 1
  ljmp _isr_EP6
  .ds 1
  ljmp _isr_EP8
  .ds 1
  ljmp _isr_IBN
  .ds 1
  ljmp _isr_reserved
  .ds 1
  ljmp _isr_EP0PING
  .ds 1
  ljmp _isr_EP1PING
  .ds 1
  ljmp _isr_EP2PING
  .ds 1
  ljmp _isr_EP4PING
  .ds 1
  ljmp _isr_EP6PING
  .ds 1
  ljmp _isr_EP8PING
  .ds 1
  ljmp _isr_ERRLIMIT
  .ds 1
  ljmp _isr_reserved
  .ds 1
  ljmp _isr_reserved
  .ds 1
  ljmp _isr_reserved
  .ds 1
  ljmp _isr_EP2ISOERR
  .ds 1
  ljmp _isr_EP4ISOERR
  .ds 1
  ljmp _isr_EP6ISOERR
  .ds 1
  ljmp _isr_EP8ISOERR
  .ds 1
  ljmp _isr_EP2PF
  .ds 1
  ljmp _isr_EP4PF
  .ds 1
  ljmp _isr_EP6PF
  .ds 1
  ljmp _isr_EP8PF
  .ds 1
  ljmp _isr_EP2EF
  .ds 1
  ljmp _isr_EP4EF
  .ds 1
  ljmp _isr_EP6EF
  .ds 1
  ljmp _isr_EP8EF
  .ds 1
  ljmp _isr_EP2FF
  .ds 1
  ljmp _isr_EP4FF
  .ds 1
  ljmp _isr_EP6FF
  .ds 1
  ljmp _isr_EP8FF
  .ds 1
  ljmp _isr_GPIFDONE
  .ds 1
  ljmp _isr_GPIFWF
  .ds 1
  ; Default handler for reserved interrupts
_isr_reserved:
  reti
